## meta-beskar/conf/layer.conf
```bitbake
# We have a conf and classes directory, add to BBPATH
BBPATH .= ":${LAYERDIR}"

# We have recipes-* directories, add to BBFILES
BBFILES += "${LAYERDIR}/recipes-*/*/*.bb \
            ${LAYERDIR}/recipes-*/*/*.bbappend"

BBFILE_COLLECTIONS += "meta-beskar"
BBFILE_PATTERN_meta-beskar = "^${LAYERDIR}/"
BBFILE_PRIORITY_meta-beskar = "7"

# meta-clang is required for compiling the extensible scheduler
LAYERDEPENDS_meta-beskar = "core clang-layer"
LAYERSERIES_COMPAT_meta-beskar = "walnascar"
```
