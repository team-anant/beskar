## meta-beskar/conf/distro/beskar.conf
```bitbake
DISTRO = "beskar"
DISTRO_NAME = "Beskar"
DISTRO_VERSION = "1.0.0"

DISTRO_FEATURES ?= "${DISTRO_FEATURES_DEFAULT} sysvinit usbgadget usbhost seccomp"
DISTRO_EXTRA_RDEPENDS += "packagegroup-core-boot"

PREFERRED_VERSION_linux-yocto ?= "6.12%"
PREFERRED_VERSION_linux-yocto-rt ?= "6.12%"
PREFERRED_PROVIDER_llvm = "clang"
PREFERRED_PROVIDER_llvm-native = "clang-native"
PREFERRED_PROVIDER_nativesdk-llvm = "nativesdk-clang"
PROVIDES:pn-clang = "llvm"
PROVIDES:pn-clang-native = "llvm-native"
PROVIDES:pn-nativesdk-clang = "nativesdk-llvm"

SDK_VERSION = "${@d.getVar('DISTRO_VERSION').replace('snapshot-${METADATA_REVISION}', 'snapshot')}"
SDK_NAME = "${DISTRO}-${TCLIBC}-${SDKMACHINE}-${IMAGE_BASENAME}-${TUNE_PKGARCH}-${MACHINE}"
SDKPATHINSTALL = "/opt/${DISTRO}/${SDK_VERSION}"

PACKAGE_CLASSES ?= "package_ipk"

TARGET_VENDOR = "-beskar"

SANITY_TESTED_DISTROS ?= "\
    beskar \n \
    debian-12 \n \
    Garuda-Soaring \
    "
```
